## components/webctrl/Kconfig.projbuild
```kconfig
menu "ESPDrone web control (captive portal)"

    config WEBCTRL_ENABLE
        bool "Control the drone from a browser (captive portal + WebSocket)"
        depends on TRANSPORT_NATIVE_WIFI
        default y
        select HTTPD_WS_SUPPORT
        help
            Phones that join the drone's Wi-Fi get the control page as captive
            portal. The page sends stick commands over a WebSocket; the drone
            answers with telemetry. See docs/webcontrol.md.

    if WEBCTRL_ENABLE

        config WEBCTRL_CAPTIVE_DNS
            bool "Answer every DNS query with the drone's address"
            default y
            help
                Needed for the automatic captive portal pop-up: the phone's
                connectivity check lands on the drone and gets redirected to the
                control page.

        config WEBCTRL_MAX_ANGLE_DEG
            int "Full stick roll / pitch angle (deg)"
            range 5 45
            default 15

        config WEBCTRL_MAX_YAW_RATE_DEG
            int "Full stick yaw rate (deg/s)"
            range 30 400
            default 120

        menu "Link loss failsafe"

            config WEBCTRL_OK_MS
                int "Commands count as fresh up to (ms)"
                range 20 500
                default 100
                help
                    Commands arrive every 20 ms. Up to this age the drone simply
                    follows the last one.

            config WEBCTRL_HOLD_MS
                int "Hold the last command up to (ms)"
                range 50 1000
                default 300
                help
                    A short gap (Wi-Fi retry, TCP retransmission) is bridged by
                    holding the last stick input. After this time the drone
                    levels out (roll, pitch and yaw rate zero, thrust not above
                    the estimated hover thrust).

            config WEBCTRL_DESCEND_MS
                int "Start descending after (ms)"
                range 300 5000
                default 1000
                help
                    After this time without fresh commands the thrust drops below
                    the estimated hover thrust and the drone sinks.

            config WEBCTRL_OFF_MS
                int "Motors off after (ms)"
                range 1000 20000
                default 4000
                help
                    After this time without fresh commands the motors stop and
                    the drone disarms. Arming again needs the throttle down.

            config WEBCTRL_DESCEND_PERCENT
                int "Descent thrust in % of the estimated hover thrust"
                range 50 100
                default 85

            config WEBCTRL_STALE_MS
                int "Drop commands that arrive later than (ms)"
                range 50 1000
                default 250
                help
                    Delay relative to the fastest frame seen in the last seconds.
                    After a TCP stall the queued old commands arrive in a burst;
                    the late ones are dropped instead of replayed.

        endmenu

        menu "Battery protection"

            config WEBCTRL_BAT_LAND_MV
                int "Forced landing below (mV, 0 = off)"
                range 0 4000
                default 3000
                help
                    In flight, when the battery voltage stays below this value
                    for WEBCTRL_BAT_LAND_DELAY_MS, the drone lands by itself. The
                    pilot keeps steering, but the thrust is limited: the limit
                    starts at the hover thrust and ramps down to zero within
                    WEBCTRL_BAT_LAND_TIME_MS. Pulling the throttle down after
                    touchdown ends it at once. Armed on the ground with an empty
                    battery, the drone disarms. The voltage sags under load, so
                    this limit is lower than the arming limit.

            config WEBCTRL_BAT_LAND_DELAY_MS
                int "The voltage has to stay low for (ms)"
                range 100 10000
                default 1000
                help
                    Short dips, e.g. while climbing, do not start the landing.

            config WEBCTRL_BAT_LAND_TIME_MS
                int "Forced landing: thrust down to zero within (ms)"
                range 2000 30000
                default 10000

            config WEBCTRL_BAT_ARM_MIN_MV
                int "No arming below (mV, 0 = off)"
                range 0 4200
                default 3400
                help
                    A 1S LiPo below about 3.4 V at rest is nearly empty and would
                    hit the landing limit right after takeoff. Compare the
                    voltage on the page with a multimeter first (bench checklist
                    in docs/e1-mini.md).

        endmenu

        config WEBCTRL_TELEMETRY_HZ
            int "Telemetry rate (Hz)"
            range 5 50
            default 20

        config WEBCTRL_MAX_CLIENTS
            int "Browser connections at the same time"
            range 1 4
            default 3
            help
                One of them can fly, the others see the telemetry.

        menu "Flips (experimental)"

            config WEBCTRL_FLIP
                bool "Allow flips on request of the web pilot"
                default y
                help
                    The pilot taps a flip button (hidden on the pages by default),
                    the drone flies the flip by itself: climb, turn at a fixed rate
                    with little thrust, level out and catch the fall. Without an
                    altitude sensor this is open loop: it needs at least 2 m of
                    height and room. Only in flight, after the hover thrust has
                    been learned. The values below are the defaults; the ground
                    station can change and store them (parameter group "flip").

            config WEBCTRL_FLIP_RATE_DPS
                int "Rotation rate (deg/s)"
                depends on WEBCTRL_FLIP
                range 360 2000
                default 800

            config WEBCTRL_FLIP_BOOST_MS
                int "Climb before the rotation (ms)"
                depends on WEBCTRL_FLIP
                range 0 600
                default 250

            config WEBCTRL_FLIP_BOOST_PERCENT
                int "Thrust while climbing (% of the hover thrust)"
                depends on WEBCTRL_FLIP
                range 100 250
                default 170

            config WEBCTRL_FLIP_SPIN_PERCENT
                int "Thrust while rotating (% of the hover thrust)"
                depends on WEBCTRL_FLIP
                range 10 150
                default 50
                help
                    Upside down the thrust pushes the drone down, so it is low
                    while turning; the motors still need some to turn the drone.

            config WEBCTRL_FLIP_EXIT_DEG
                int "Level out this far before upright (deg)"
                depends on WEBCTRL_FLIP
                range 10 120
                default 70
                help
                    The attitude controller takes over this many degrees before
                    the drone is upright again, to brake the rotation in time.

            config WEBCTRL_FLIP_RECOVER_MS
                int "Catching after the rotation (ms)"
                depends on WEBCTRL_FLIP
                range 0 1000
                default 350

            config WEBCTRL_FLIP_RECOVER_PERCENT
                int "Thrust while catching (% of the hover thrust)"
                depends on WEBCTRL_FLIP
                range 50 250
                default 140

            config WEBCTRL_FLIP_TIMEOUT_MS
                int "Longest rotation (ms)"
                depends on WEBCTRL_FLIP
                range 300 1500
                default 900
                help
                    If the drone has not turned over by then, it levels out
                    without finishing the flip.

        endmenu

        config WEBCTRL_MOTOR_TEST_MAX_PERCENT
            int "Motor test: highest power in percent (0 = no motor test)"
            range 0 50
            default 30
            help
                The desktop ground station (tools/groundstation) can spin single
                motors on the bench, propellers off, to check the motor order
                and direction. This caps the power; a test also stops after
                3 seconds, when the ground station disconnects, or on STOP.
                0 switches the motor test off.

    endif

endmenu
```
