## main/Kconfig.projbuild
```kconfig
menu "ESPDrone Config"

    choice
        prompt "ESP_Drone hardware version"
        default TARGET_ESP32_S2_DRONE_V1_2 if IDF_TARGET_ESP32S3
        default TARGET_ESP32_S2_DRONE_V1_2 if IDF_TARGET_ESP32S2
        default TARGET_E1_MINI if IDF_TARGET_ESP32
        default TARGET_PORTABLE_SAFE if IDF_TARGET_ESP32P4 || IDF_TARGET_ESP32S31

        config TARGET_ESPLANE_V1
            bool "esplane with esp32 onboard(old version )"

        config TARGET_ESPLANE_V2_S2
            bool "esplane with esp32-s2 onboard"

        config TARGET_ESP32_S2_DRONE_V1_2
            bool "esp-drone with ESP32-S2/ESP32-S3 onboard"

        config TARGET_E1_MINI
            bool "E1 Mini / ESP32 Drone kit (ESP32 DevKit 30 pin, MPU6500 on SPI)"
            depends on IDF_TARGET_ESP32
            help
                Mini quadcopter kit: a plain ESP32 DevKit V1 (30 pin) plugged onto
                the frame PCB, an MPU6500 on SPI without interrupt line and four
                brushed 8520 motors driven by AO3416 MOSFETs.
                See docs/e1-mini.md for the pinout and the bench test checklist.

        config TARGET_PORTABLE_SAFE
            bool "portable safe profile (outputs disabled)"
            help
                Build the portable flight-control core without assuming an
                existing ESP-Drone PCB pinout. Motor and board peripherals
                remain disabled until a real board profile is supplied.

    endchoice

    choice TRANSPORT
        prompt "CRTP transport"
        default TRANSPORT_NATIVE_WIFI if SOC_WIFI_SUPPORTED
        default TRANSPORT_NONE

        config TRANSPORT_NATIVE_WIFI
            bool "native Wi-Fi"
            depends on SOC_WIFI_SUPPORTED

        config TRANSPORT_NONE
            bool "no radio (diagnostic/safe mode)"
            help
                Start the firmware with a blocking no-op CRTP link. This is
                the default for targets such as ESP32-P4 without a radio
                companion chip.

        config TRANSPORT_REMOTE_WIFI
            bool "remote Wi-Fi (integration skeleton)"
            depends on IDF_TARGET_ESP32P4 && ESP_WIFI_REMOTE_ENABLED
            help
                Compile against IDF Wi-Fi Remote. A matching esp-extconn
                transport and companion firmware are still required and are
                board-specific; this option is not part of hardware sign-off.
    endchoice

    choice
        prompt "extend board version"
        default EXT_AUTO_DETECT
        config EXT_FLOW_TESTBOARD
            bool "use testboard 200616"
            help
                This board use wrong pin definition,only for test.
        config EXT_AUTO_DETECT
            bool "auto detect"
            help
                enable this to use extend board.
    endchoice

    menu "app set"
        config ENABLE_LEGACY_APP
            bool "Enable legacy ESPlane1.0 APP"
            default n
            help
                This enables the udp_server_rx2_task of wifi.
        config ENABLE_POSITION_HOLD_MODE
            bool "Enable position hold mode"
            default y
            help
                This enables position hold mode when pmw3901 sensors available.
        config ENABLE_COMMAND_MODE_SET
            bool "Enable \'setCommandermode\' to transform command"
            depends on ENABLE_POSITION_HOLD_MODE
            default y if ENABLE_POSITION_HOLD_MODE
            default n if !ENABLE_POSITION_HOLD_MODE
            help
                This enables assit mode when use old version app.
        config CRTP_AUTO_ARM
            bool "Arm motors when a CRTP pilot unlocks the throttle"
            default y
            help
                The drone starts disarmed. With this option, a CRTP pilot (mobile
                app, cfclient, ESP-NOW joystick) arms the motors by sending one
                setpoint with zero thrust, as the original firmware expected. The
                arm is released again when its setpoints stop for
                COMMANDER_WDT_TIMEOUT_SHUTDOWN (2 s).
                Without this option a CRTP pilot has to set the parameter
                system.forceArm.
    endmenu

    menu "wireless config"
        config ESPNOW_CONTROL
            bool "Enhanced ESP-NOW control channel"
            depends on TRANSPORT_NATIVE_WIFI
            default n if IDF_TARGET_ESP32S31
            default y
            help
                Enable the controller protocol implemented with Espressif's
                enhanced esp-now component.  ESP32-S31 preview headers are
                not yet compatible with esp-now 2.5.3, so its native Wi-Fi
                and UDP transport remain enabled while this channel is gated.

        config WIFI_BASE_SSID
            string "Wi-Fi Base SSID"
            default "ESP-DRONE"
            help
                Wi-Fi Base SSID, 1-16 characters. the final SSID will be BASE_SSID-MAC
        config WIFI_PASSWORD
            string "Wi-Fi Password"
            default "12345678"
            help
                Wi-Fi Password, empty for an open AP or 8-63 characters
        config WIFI_CHANNEL
            int "Wi-Fi/ESP-Now Channel"
            range 1 13
            default 6
            help
                Wi-Fi/ESP-Now Channel, 1-13
        config WIFI_MAX_STA_CONN
            int "Wi-Fi Max Station Connection"
            range 1 6
            default 3
            help
                Wi-Fi Max Station Connection, 1-6
    endmenu

    menu "calibration angle"
        config PITCH_CALIB
            int "PITCH_CALIB deg*100"
            range -200 200
            default 0
            help
                if PITCH error angle is 0.90,set this 90

        config ROLL_CALIB
            int "ROLL_CALIB deg*100"
            range -200 200
            default 0
            help
                if ROLL error angle is 0.90,set this 90
    endmenu

    menu "system"

        config BASE_STACK_SIZE
            int "base stack size for system task"
            range 512 1024
            default 1024 if IDF_TARGET_ESP32
            default 512 if IDF_TARGET_ESP32S2
            default 1024 if IDF_TARGET_ESP32S3
            default 1024 if TARGET_PORTABLE_SAFE

    endmenu

    menu "buzzer"

        config BUZZER_ON
            bool "enable buzzer to play sound"
            default n if TARGET_PORTABLE_SAFE
            default n if TARGET_E1_MINI
            default y

        config BUZ1_PIN_POS
            int "BUZ1_PIN_POS GPIO number"
            range 0 33 if TARGET_E1_MINI
            default 26 if TARGET_E1_MINI
            range 0 34 if TARGET_ESPLANE_V1
            default 27 if TARGET_ESPLANE_V1
            range 0 43 if TARGET_ESPLANE_V2_S2
            default 39 if TARGET_ESPLANE_V2_S2
            range 0 43 if TARGET_ESP32_S2_DRONE_V1_2
            default 39 if TARGET_ESP32_S2_DRONE_V1_2
            default 0 if TARGET_PORTABLE_SAFE
            help
                GPIO number (IOxx) BUZ1_PIN_POS. Only used when BUZZER_ON is set
                (the E1 Mini has no buzzer).

        config BUZ2_PIN_NEG
            int "BUZ2_PIN_NEG GPIO number"
            range 0 33 if TARGET_E1_MINI
            default 27 if TARGET_E1_MINI
            range 0 34 if TARGET_ESPLANE_V1
            default 26 if TARGET_ESPLANE_V1
            range 0 43 if TARGET_ESPLANE_V2_S2
            default 38 if TARGET_ESPLANE_V2_S2
            range 0 43 if TARGET_ESP32_S2_DRONE_V1_2
            default 38 if TARGET_ESP32_S2_DRONE_V1_2
            default 0 if TARGET_PORTABLE_SAFE
            help
                GPIO number (IOxx) BUZ2_PIN_NEG. Only used when BUZZER_ON is set.

    endmenu

    menu "sensors config"
        choice IMU_TYPE
            prompt "IMU (gyroscope and accelerometer)"
            default IMU_MPU6500_SPI if TARGET_E1_MINI
            default IMU_MPU6050_I2C

            config IMU_MPU6050_I2C
                bool "MPU6050 on I2C0 with data-ready interrupt"

            config IMU_MPU6500_SPI
                bool "MPU6500 / MPU9250 on SPI, sampled by a 1 kHz hardware timer"
                help
                    The sensor shares the SPI bus (SPI_PIN_CLK/MISO/MOSI) with the
                    optional PMW3901 flow sensor and has its own chip select.
                    No interrupt line is needed.
        endchoice

        config IMU_SPI_PIN_CS
            int "IMU SPI chip select GPIO number"
            depends on IMU_MPU6500_SPI
            range 0 33 if IDF_TARGET_ESP32
            range 0 48
            default 5

        config IMU_SPI_CLOCK_HZ
            int "IMU SPI clock for sensor reads (Hz)"
            depends on IMU_MPU6500_SPI
            range 1000000 20000000
            default 8000000
            help
                Register writes always run at 1 MHz (datasheet limit). Reading
                the sensor registers is allowed up to 20 MHz. Lower this value if
                the wiring is long or the readings are noisy.

        choice IMU_ROTATION
            prompt "IMU mounting: sensor axes to body axes"
            depends on IMU_MPU6500_SPI
            default IMU_ROTATION_270 if TARGET_E1_MINI
            default IMU_ROTATION_0
            help
                Body frame: X forward, Y left, Z up (Crazyflie convention).
                E1 Mini: the sensor's Y axis points forward and its X axis to the
                right (vendor firmware: imuRotation yaw = -90 deg), i.e. 270 deg.
                Check it on the bench as described in docs/e1-mini.md.

            config IMU_ROTATION_0
                bool "0 deg: body X = sensor X, body Y = sensor Y"
            config IMU_ROTATION_90
                bool "90 deg: body X = -sensor Y, body Y = sensor X"
            config IMU_ROTATION_180
                bool "180 deg: body X = -sensor X, body Y = -sensor Y"
            config IMU_ROTATION_270
                bool "270 deg: body X = sensor Y, body Y = -sensor X (E1 Mini)"
        endchoice

        config IMU_UPSIDE_DOWN
            bool "IMU is mounted upside down (rotated 180 deg about body X)"
            depends on IMU_MPU6500_SPI
            default n

        config I2C0_PIN_SDA
            int "I2C0_PIN_SDA GPIO number"
            range 0 33 if TARGET_E1_MINI
            default 21 if TARGET_E1_MINI
            range 0 34 if TARGET_ESPLANE_V1
            default 21 if TARGET_ESPLANE_V1
            range 0 43 if TARGET_ESPLANE_V2_S2
            default 11 if TARGET_ESPLANE_V2_S2
            range 0 43 if TARGET_ESP32_S2_DRONE_V1_2
            default 11 if TARGET_ESP32_S2_DRONE_V1_2
            default 0 if TARGET_PORTABLE_SAFE
            help
                GPIO number (IOxx) I2C0_PIN_SDA. I2C0 is the MPU6050 bus; it is not
                started when the IMU is on SPI (E1 Mini).

        config I2C0_PIN_SCL
            int "I2C0_PIN_SCL GPIO number"
            range 0 33 if TARGET_E1_MINI
            default 22 if TARGET_E1_MINI
            range 0 34 if TARGET_ESPLANE_V1
            default 22 if TARGET_ESPLANE_V1
            range 0 43 if TARGET_ESPLANE_V2_S2
            default 10 if TARGET_ESPLANE_V2_S2
            range 0 43 if TARGET_ESP32_S2_DRONE_V1_2
            default 10 if TARGET_ESP32_S2_DRONE_V1_2
            default 0 if TARGET_PORTABLE_SAFE
            help
                GPIO number (IOxx) I2C0_PIN_SCL

        config I2C1_PIN_SDA
            int "I2C1_PIN_SDA GPIO number"
            range 0 33 if TARGET_E1_MINI
            default 21 if TARGET_E1_MINI
            range 0 34 if TARGET_ESPLANE_V1
            default 16 if TARGET_ESPLANE_V1
            range 0 43 if TARGET_ESPLANE_V2_S2
            default 40 if TARGET_ESPLANE_V2_S2
            range 0 43 if TARGET_ESP32_S2_DRONE_V1_2
            default 40 if TARGET_ESP32_S2_DRONE_V1_2
            default 0 if TARGET_PORTABLE_SAFE
            help
                GPIO number (IOxx) I2C1_PIN_SDA. I2C1 is the expansion bus
                (VL53L1X range sensor, config EEPROM).

        config I2C1_PIN_SCL
            int "I2C1_PIN_SCL GPIO number"
            range 0 33 if TARGET_E1_MINI
            default 22 if TARGET_E1_MINI
            range 0 34 if TARGET_ESPLANE_V1
            default 17 if TARGET_ESPLANE_V1
            range 0 43 if TARGET_ESPLANE_V2_S2
            default 41 if TARGET_ESPLANE_V2_S2
            range 0 43 if TARGET_ESP32_S2_DRONE_V1_2
            default 41 if TARGET_ESP32_S2_DRONE_V1_2
            default 0 if TARGET_PORTABLE_SAFE
            help
                GPIO number (IOxx) I2C1_PIN_SCL

        config SPI_PIN_MISO
            int "SPI_PIN_MISO GPIO number"
            range 0 39 if TARGET_E1_MINI
            default 19 if TARGET_E1_MINI
            range 0 34 if TARGET_ESPLANE_V1
            default 12 if TARGET_ESPLANE_V1
            range 0 43 if TARGET_ESPLANE_V2_S2
            default 37 if TARGET_ESPLANE_V2_S2
            range 0 43 if TARGET_ESP32_S2_DRONE_V1_2
            default 37 if TARGET_ESP32_S2_DRONE_V1_2
            default 0 if TARGET_PORTABLE_SAFE
            help
                GPIO number (IOxx) SPI_PIN_MISO

        config SPI_PIN_MOSI
            int "SPI_PIN_MOSI GPIO number"
            range 0 33 if TARGET_E1_MINI
            default 23 if TARGET_E1_MINI
            range 0 34 if TARGET_ESPLANE_V1
            default 13 if TARGET_ESPLANE_V1
            range 0 43 if TARGET_ESPLANE_V2_S2
            default 35 if TARGET_ESPLANE_V2_S2
            range 0 43 if TARGET_ESP32_S2_DRONE_V1_2
            default 35 if TARGET_ESP32_S2_DRONE_V1_2
            default 0 if TARGET_PORTABLE_SAFE
            help
                GPIO number (IOxx) SPI_PIN_MOSI

        config SPI_PIN_CLK
            int "SPI_PIN_CLK GPIO number"
            range 0 33 if TARGET_E1_MINI
            default 18 if TARGET_E1_MINI
            range 0 34 if TARGET_ESPLANE_V1
            default 14 if TARGET_ESPLANE_V1
            range 0 43 if TARGET_ESPLANE_V2_S2
            default 36 if TARGET_ESPLANE_V2_S2
            range 0 43 if TARGET_ESP32_S2_DRONE_V1_2
            default 36 if TARGET_ESP32_S2_DRONE_V1_2
            default 0 if TARGET_PORTABLE_SAFE
            help
                GPIO number (IOxx) SPI_PIN_CLK

        config SPI_PIN_CS0
            int "SPI_PIN_CS0 GPIO number"
            range 0 33 if TARGET_E1_MINI
            default 33 if TARGET_E1_MINI
            range 0 34 if TARGET_ESPLANE_V1
            default 15 if TARGET_ESPLANE_V1
            range 0 43 if TARGET_ESPLANE_V2_S2
            default 34 if TARGET_ESPLANE_V2_S2
            range 0 43 if TARGET_ESP32_S2_DRONE_V1_2
            default 34 if TARGET_ESP32_S2_DRONE_V1_2
            default 0 if TARGET_PORTABLE_SAFE
            help
                GPIO number (IOxx) SPI_PIN_CS0 (chip select of the PMW3901 flow
                sensor on the expansion board).

        config MPU_PIN_INT
            int "MPU_PIN_INT GPIO number"
            range -1 39 if TARGET_E1_MINI
            default -1 if TARGET_E1_MINI
            range 0 34 if TARGET_ESPLANE_V1
            default 19 if TARGET_ESPLANE_V1
            range 0 43 if TARGET_ESPLANE_V2_S2
            default 12 if TARGET_ESPLANE_V2_S2
            range 0 43 if TARGET_ESP32_S2_DRONE_V1_2
            default 12 if TARGET_ESP32_S2_DRONE_V1_2
            default 0 if TARGET_PORTABLE_SAFE
            help
                GPIO number (IOxx) MPU_PIN_INT. Only used by the MPU6050 driver;
                -1 = not connected.

        config ADC1_PIN
            int "Battery voltage ADC1 GPIO number"
            range 32 39 if TARGET_E1_MINI
            default 36 if TARGET_E1_MINI
            range 32 39 if TARGET_ESPLANE_V1
            default 35 if TARGET_ESPLANE_V1
            range 1 10 if TARGET_ESPLANE_V2_S2
            default 2 if TARGET_ESPLANE_V2_S2
            range 1 10 if TARGET_ESP32_S2_DRONE_V1_2
            default 2 if TARGET_ESP32_S2_DRONE_V1_2
            default 0 if TARGET_PORTABLE_SAFE
            help
                GPIO number (IOxx) of the battery voltage divider. Must be an ADC1
                pin (ADC2 does not work while Wi-Fi is on).

        config BATTERY_DIVIDER_X1000
            int "Battery voltage divider ratio x1000 (Vbat / Vadc)"
            range 1000 10000
            default 1303 if TARGET_E1_MINI
            default 2000
            help
                E1 Mini: 10k from the battery, 33k to ground, so
                Vbat = Vadc * 43 / 33 = Vadc * 1.303.

        config EXT01_PIN
            int "EXT01_PIN GPIO number"
            range 0 39 if TARGET_E1_MINI
            default 32 if TARGET_E1_MINI
            range 0 34 if TARGET_ESPLANE_V1
            default 34 if TARGET_ESPLANE_V1
            range 0 43 if TARGET_ESPLANE_V2_S2
            default 1 if TARGET_ESPLANE_V2_S2
            range 0 43 if TARGET_ESP32_S2_DRONE_V1_2
            default 1 if TARGET_ESP32_S2_DRONE_V1_2
            default 0 if TARGET_PORTABLE_SAFE
            help
                GPIO number (IOxx) EXT01_PIN
    endmenu

    menu "led config"
        config LED_PIN_BLUE
            int "LED_PIN_BLUE GPIO number"
            range -1 33 if TARGET_E1_MINI
            default 2 if TARGET_E1_MINI
            range 0 34 if TARGET_ESPLANE_V1
            default 18 if TARGET_ESPLANE_V1
            range 0 43 if TARGET_ESPLANE_V2_S2
            default 7 if TARGET_ESPLANE_V2_S2
            range 0 43 if TARGET_ESP32_S2_DRONE_V1_2
            default 7 if TARGET_ESP32_S2_DRONE_V1_2
            default 0 if TARGET_PORTABLE_SAFE
            help
                GPIO number (IOxx) LED_PIN_BLUE, -1 = not connected.
                On the E1 Mini this is the blue LED of the DevKit (GPIO2).

        config LED_PIN_GREEN
            int "LED_PIN_GREEN GPIO number"
            range -1 33 if TARGET_E1_MINI
            default -1 if TARGET_E1_MINI
            range 0 34 if TARGET_ESPLANE_V1
            default 5 if TARGET_ESPLANE_V1
            range 0 43 if TARGET_ESPLANE_V2_S2
            default 9 if TARGET_ESPLANE_V2_S2
            range 0 43 if TARGET_ESP32_S2_DRONE_V1_2
            default 9 if TARGET_ESP32_S2_DRONE_V1_2
            default 0 if TARGET_PORTABLE_SAFE
            help
                GPIO number (IOxx) LED_PIN_GREEN, -1 = not connected

        config LED_PIN_RED
            int "LED_PIN_RED GPIO number"
            range -1 33 if TARGET_E1_MINI
            default -1 if TARGET_E1_MINI
            range 0 34 if TARGET_ESPLANE_V1
            default 23 if TARGET_ESPLANE_V1
            range 0 43 if TARGET_ESPLANE_V2_S2
            default 8 if TARGET_ESPLANE_V2_S2
            range 0 43 if TARGET_ESP32_S2_DRONE_V1_2
            default 8 if TARGET_ESP32_S2_DRONE_V1_2
            default 0 if TARGET_PORTABLE_SAFE
            help
                GPIO number (IOxx) LED_PIN_RED, -1 = not connected

    endmenu

    menu "motors config"
        choice
            prompt "Motor type"
            default MOTOR_BRUSHED_8520 if TARGET_E1_MINI
            default MOTOR_BRUSHED_715 if TARGET_ESPLANE_V1 || TARGET_ESPLANE_V2_S2
            default MOTOR_BRUSHED_720 if TARGET_ESP32_S2_DRONE_V1_2
            default MOTOR_BRUSHED_720 if TARGET_PORTABLE_SAFE
            
            config MOTOR_BRUSHED_715
                bool "brushed 715 motor"
    
            config MOTOR_BRUSHED_720
                bool "brushed 720 motor"

            config MOTOR_BRUSHED_8520
                bool "brushed 8520 motor"
        endchoice

        config MOTORS_STARTUP_TEST
            bool "Spin motors during startup self-test"
            default n
            help
                Briefly drives each motor during boot. Keep disabled for safe
                bench testing; enable only when propellers have been removed.

        config MOTOR01_PIN
            int "MOTOR01_PIN GPIO number"
            range 0 33 if TARGET_E1_MINI
            default 15 if TARGET_E1_MINI
            range 0 34 if TARGET_ESPLANE_V1
            default 4 if TARGET_ESPLANE_V1
            range 0 43 if TARGET_ESPLANE_V2_S2
            default 3 if TARGET_ESPLANE_V2_S2
            range 0 43 if TARGET_ESP32_S2_DRONE_V1_2
            default 5 if TARGET_ESP32_S2_DRONE_V1_2
            default 0 if TARGET_PORTABLE_SAFE
            help
                GPIO number (IOxx) MOTOR01_PIN. M1 is front right
                (E1 Mini: GPIO15).

        config MOTOR02_PIN
            int "MOTOR02_PIN GPIO number"
            range 0 33 if TARGET_E1_MINI
            default 13 if TARGET_E1_MINI
            range 0 34 if TARGET_ESPLANE_V1
            default 33 if TARGET_ESPLANE_V1
            range 0 43 if TARGET_ESPLANE_V2_S2
            default 4 if TARGET_ESPLANE_V2_S2
            range 0 43 if TARGET_ESP32_S2_DRONE_V1_2
            default 6 if TARGET_ESP32_S2_DRONE_V1_2
            default 0 if TARGET_PORTABLE_SAFE
            help
                GPIO number (IOxx) MOTOR02_PIN. M2 is rear right
                (E1 Mini: GPIO13).

        config MOTOR03_PIN
            int "MOTOR03_PIN GPIO number"
            range 0 33 if TARGET_E1_MINI
            default 12 if TARGET_E1_MINI
            range 0 34 if TARGET_ESPLANE_V1
            default 32 if TARGET_ESPLANE_V1
            range 0 43 if TARGET_ESPLANE_V2_S2
            default 5 if TARGET_ESPLANE_V2_S2
            range 0 43 if TARGET_ESP32_S2_DRONE_V1_2
            default 3 if TARGET_ESP32_S2_DRONE_V1_2
            default 0 if TARGET_PORTABLE_SAFE
            help
                GPIO number (IOxx) MOTOR03_PIN. M3 is rear left
                (E1 Mini: GPIO12).

        config MOTOR04_PIN
            int "MOTOR04_PIN GPIO number"
            range 0 33 if TARGET_E1_MINI
            default 14 if TARGET_E1_MINI
            range 0 34 if TARGET_ESPLANE_V1
            default 25 if TARGET_ESPLANE_V1
            range 0 43 if TARGET_ESPLANE_V2_S2
            default 6 if TARGET_ESPLANE_V2_S2
            range 0 43 if TARGET_ESP32_S2_DRONE_V1_2
            default 4 if TARGET_ESP32_S2_DRONE_V1_2
            default 0 if TARGET_PORTABLE_SAFE
            help
                GPIO number (IOxx) MOTOR04_PIN. M4 is front left
                (E1 Mini: GPIO14).


        config MOTOR_PWM_FREQ_HZ
            int "Motor PWM frequency (Hz)"
            range 1000 40000
            default 25000 if TARGET_E1_MINI
            default 15000
            help
                PWM frequency for brushed motors driven by MOSFETs. The E1 Mini
                vendor firmware uses 25 kHz.

        config MOTOR_PWM_BITS
            int "Motor PWM resolution (bits)"
            range 8 10
            default 10 if TARGET_E1_MINI
            default 8

        config MOTOR_YAW_INVERT
            bool "Invert the yaw output of the motor mixer"
            default n
            help
                The mixer expects M1 and M3 to spin opposite to M2 and M4 as on the
                Crazyflie. If the drone turns the wrong way on a yaw command (or
                starts spinning around its vertical axis by itself), the
                propellers spin the other way round: enable this option.
    endmenu


endmenu
```
